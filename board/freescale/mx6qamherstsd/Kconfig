## board/freescale/mx6qamherstsd/Kconfig
```kconfig
if TARGET_MX6QAMHERSTSD

config SYS_CPU
	default "armv7"

config SYS_BOARD
	default "mx6qamherstsd"

config SYS_VENDOR
	default "freescale"

config SYS_CONFIG_NAME
	default "mx6qamherstsd"

config SYS_SOC
	default "mx6"

endif
```
